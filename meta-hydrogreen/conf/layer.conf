## meta-hydrogreen/conf/layer.conf
```bitbake
BBPATH .= ":${LAYERDIR}"

BBFILES += "${LAYERDIR}/recipes-*/*/*.bb \
            ${LAYERDIR}/recipes-*/*/*.bbappend"

BB_FETCH_TIMEOUT = "1200000"

BBFILE_COLLECTIONS += "hydrogreen"
BBFILE_PATTERN_hydrogreen = "^${LAYERDIR}/"
BBFILE_PRIORITY_hydrogreen = "10"

LAYERSERIES_COMPAT_hydrogreen = "scarthgap"
LAYERDEPENDS_hydrogreen = "raspberrypi"
```
